// SPDX-License-Identifier: (GPL-2.0+ OR BSD-3-Clause)
/*
 * Copyright (C) STMicroelectronics 2021-2024 - All Rights Reserved
 * Author: Alexandre Torgue <alexandre.torgue@foss.st.com> for STMicroelectronics.
 */

&etzpc {
	cryp: crypto@54002000 {
		compatible = "st,stm32mp1-cryp";
		reg = <0x54002000 0x400>;
		interrupts = <GIC_SPI 80 IRQ_TYPE_LEVEL_HIGH>;
		clocks = <&rcc CRYP1>;
		resets = <&rcc CRYP1_R>;
		access-controllers = <&etzpc STM32MP1_ETZPC_CRYP_ID>;
		status = "disabled";
	};

	saes: saes@54005000 {
		compatible = "st,stm32mp13-saes";
		reg = <0x54005000 0x400>;
		interrupts = <GIC_SPI 82 IRQ_TYPE_LEVEL_HIGH>;
		clocks = <&rcc SAES_K>, <&rcc RNG1_K>;
		clock-names = "bus", "rng";
		resets = <&rcc SAES_R>;
		access-controllers = <&etzpc STM32MP1_ETZPC_SAES_ID>, <&etzpc STM32MP1_ETZPC_RNG_ID>;
		status = "disabled";
	};

	pka: pka@54006000 {
		compatible = "st,stm32mp13-pka";
		reg = <0x54006000 0x2000>;
		interrupts = <GIC_SPI 105 IRQ_TYPE_LEVEL_HIGH>;
		clocks = <&rcc PKA>, <&rcc RNG1_K>;
		clock-names = "bus", "rng";
		resets = <&rcc PKA_R>;
		access-controllers = <&etzpc STM32MP1_ETZPC_PKA_ID>, <&etzpc STM32MP1_ETZPC_RNG_ID>;
		status = "disabled";
	};
};
