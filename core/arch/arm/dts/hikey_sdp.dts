/*
 * Copyright (c) 2021, NXP. All rights reserved.
 *
 * SPDX-License-Identifier: BSD-3-Clause
 */

/dts-v1/;

/ {
	#address-cells = <1>;
	#size-cells = <0>;

	reserved-memory {
		#address-cells = <1>;
		#size-cells = <1>;

		sdp@0x3e800000 {
			reg = <0x3E800000 0x00400000>;
		};
	};
};
