// SPDX-License-Identifier: BSD-2-Clause
/*
 *  Copyright (c) 2022, Linaro Limited
 */
/dts-v1/;

#include "dt_driver_test.dtsi"

/ {
	model = "Embedded device tree for OP-TEE/Qemu platform test purpose";
};
