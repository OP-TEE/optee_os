// SPDX-License-Identifier: (GPL-2.0+ OR BSD-3-Clause)
/*
 * Copyright (C) STMicroelectronics 2023
 */
/dts-v1/;

#include "stm32mp157c-ev1.dts"

/ {
	model = "STMicroelectronics STM32MP157C SCMI eval daughter on eval mother";
	compatible = "st,stm32mp157c-ev1-scmi", "st,stm32mp157c-ed1-scmi", "st,stm32mp157";
};

&rcc {
	compatible = "st,stm32mp1-rcc-secure";
	status = "okay";
};
