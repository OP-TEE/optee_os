// SPDX-License-Identifier: BSD-3-Clause
/*
 * Copyright (c) Qualcomm Technologies, Inc. and/or its subsidiaries.
 */

/dts-v1/;

/ {
	compatible = "qcom,eliza-cqs-evk-emmc", "qcom,eliza-cqs-evk",
		     "qcom,eliza-cqs-som-emmc", "qcom,eliza-cqs-som",
		     "qcom,eliza";
	model = "Qualcomm Technologies, Inc. Eliza CQS EVK (eMMC)";
	#address-cells = <2>;
	#size-cells = <2>;

	memory@80000000 {
		device_type = "memory";
		reg = <0x0 0x80000000 0x0 0x80000000>,
		      <0x8 0x80000000 0x7 0x80000000>;
	};

	soc {
		compatible = "simple-bus";
		#address-cells = <2>;
		#size-cells = <2>;
		ranges;

		interrupt-controller@17100000 {
			compatible = "arm,gic-v3";
			reg = <0x0 0x17100000 0x0 0x10000>,	/* GICD */
			      <0x0 0x17180000 0x0 0x200000>;	/* GICR */
			interrupt-controller;
			#address-cells = <0>;
			#interrupt-cells = <3>;
		};
	};
};
