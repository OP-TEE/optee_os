// SPDX-License-Identifier: BSD-2-Clause
/*
 *  Copyright (c) 2022, Linaro Limited
 */

/dts-v1/;

/ {
	#address-cells = <1>;
	#size-cells = <0>;

	reserved-memory {
		#address-cells = <1>;
		#size-cells = <1>;

		sdp@3e800000 {
			compatible = "linaro,secure-heap";
			no-map;
			reg = <0x3E800000 0x00400000>;
		};
	};
};
